byte leds[8] = {
4, // A
5, // B
3, // C
12, // D
13, // E
11, // F
10, // G
2 // DP
};
char symbols[10] = {'0','1','2','3','4','5','6','7','8','9'};
byte encode[10][8] = {
//{A, B, C, D, E, F, G,DP},
{1, 1, 1, 1, 1, 1, 0, 0}, // 0
{0, 1, 1, 0, 0, 0, 0, 0}, // 1
{1, 1, 0, 1, 1, 0, 1, 0}, // 2
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{1, 1, 1, 1, 0, 1, 1, 0} // 9;
};
void setup()
{
for (int i = 0; i < 8; i++)
{
pinMode (leds [i] , OUTPUT);
digitalWrite(leds[i], 0);
}
};
void loop()
{
for (int s =0;0<10; s++);{
for (int i =0;0<8; i++); {
digitalWrite (leds[i],encode[s][i]);
 }
delay(1000);
 }
}